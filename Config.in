## Config.in
```kconfig
mainmenu "Toybox Configuration"


source generated/Config.probed
source generated/Config.in

comment ""

menu "Toybox global settings"

# This entry controls the multiplexer, disabled for single command builds
config TOYBOX
	bool
	default y
	help
	  usage: toybox [--long | --version | [command] [arguments...]]

	  With no arguments, shows available commands. First argument is
	  name of a command to run, followed by any arguments to that command.

	  --long	Show path to each command
	  --version	Show toybox version

	  To install command symlinks, try:
	    for i in $(/bin/toybox --long); do ln -s /bin/toybox $i; done

config TOYBOX_SUID
	bool "SUID support"
	default y
	help
	  Support for the Set User ID bit, to install toybox suid root and drop
	  permissions for commands which do not require root access. To use
	  this change ownership of the file to the root user and set the suid
	  bit in the file permissions:

	  chown root:root toybox; chmod +s toybox

choice
	prompt "Security Blanket"
	default TOYBOX_LSM_NONE
	help
	  Select a Linux Security Module to complicate your system
	  until you can't find holes in it.

config TOYBOX_LSM_NONE
	bool "None"
	help
          Don't try to achieve "watertight" by plugging the holes in a
          collander, instead use conventional unix security (and possibly
          Linux Containers) for a simple straightforward system.
	  
config TOYBOX_SELINUX
	bool "SELinux support"
	help
	  Include SELinux options in commands such as ls, and add
	  SELinux-specific commands such as chcon to the Android menu.

config TOYBOX_SMACK
	bool "SMACK support"
	help
	  Include SMACK options in commands like ls for systems like Tizen.

endchoice

config TOYBOX_FLOAT
	bool "Floating point support"
	default y
	help
	  Include floating point support infrastructure and commands that
	  require it.

config TOYBOX_HELP
	bool "Help messages"
	default y
	help
	  Include help text for each command.

config TOYBOX_HELP_DASHDASH
	bool "--help"
	default y
	depends on TOYBOX_HELP
	help
	  Support --help argument in all commands, even ones with a NULL
	  optstring. Produces the same output as "help command".

config TOYBOX_I18N
	bool "Internationalization support"
	default y
	help
	  Support for UTF-8 character sets, and some locale support.

config TOYBOX_FREE
	bool "Free memory unnecessarily"
	default n
	help
	  When a program exits, the operating system will clean up after it
	  (free memory, close files, etc). To save size, toybox usually relies
	  on this behavior. If you're running toybox under a debugger or
	  without a real OS (ala newlib+libgloss), enable this to make toybox
	  clean up after itself.

config TOYBOX_NORECURSE
	bool "Disable recursive execution"
	default n
	help
	  When one toybox command calls another, usually it just calls the new
	  command's main() function rather than searching the $PATH and calling
	  exec on another file (which is much slower).

	  This disables that optimization, so toybox will run external commands
          even when it has a built-in version of that command. This requires
          toybox symlinks to be installed in the $PATH, or re-invoking the
          "toybox" multiplexer command by name.

config TOYBOX_DEBUG
	bool "Debugging tests"
	default n
	help
	  Enable extra checks for debugging purposes. All of them catch
          things that can only go wrong at development time, not runtime.

config TOYBOX_UID_SYS
	int "First system UID"
	default 100
	help
	  When commands like useradd/groupadd allocate system IDs, start here.

config TOYBOX_UID_USR
	int "First user UID"
	default 500
	help
	  When commands like useradd/groupadd allocate user IDs, start here.
endmenu
```

## lib/Config.in
```kconfig
menu "Toys"

config CONFIG_DF
	bool "df (disk free)"
	default n
	help
	  usage: df [-t type] [FILESYSTEM ...]

	  The "disk free" command, df shows total/used/available disk space for
	  each filesystem listed on the command line, or all currently mounted
	  filesystems.

	  -t type
		Display only filesystems of this type.

config CONFIG_DF_PEDANTIC
	bool "options -P and -k"
	default n
	depends on CONFIG_DF
	help
	  usage: df [-Pk]

	  -P	The SUSv3 "Pedantic" option

		Provides a slightly less useful output format dictated by
		the Single Unix Specification version 3, and sets the
		units to 512 bytes instead of the default 1024 bytes.

	  -k	Sets units back to 1024 bytes (the default without -P)

config CONFIG_TOYSH
	bool "sh (toysh)"
	default n
	help
	  usage: sh [-c command] [script]

	  The toybox command shell.  Runs a shell script, or else reads input
	  interactively and responds to it.

	  -c	command line to execute

config CONFIG_TOYSH_TTY
	bool "Interactive shell (terminal control)"
	default n
	depends on CONFIG_TOYSH
	help
	  Add terminal control to toysh.  This is necessary for interactive use,
	  so the shell isn't killed by CTRL-C.

config CONFIG_TOYSH_PROFILE
	bool "Profile support"
	default n
	depends on CONFIG_TOYSH_TTY
	help
	  Read /etc/profile and ~/.profile when running interactively.

	  Also enables the built-in command "source".

config CONFIG_TOYSH_JOBCTL
	bool "Job Control (fg, bg, jobs)"
	default n
	depends on CONFIG_TOYSH_TTY
	help
	  Add job cocntrol to toysh.  This lets toysh handle CTRL-Z, and enables
	  the built-in commands "fg", "bg", and "jobs".

	  With pipe support, enable use of "&" to run background processes.

config CONFIG_TOYSH_FLOWCTL
	bool "Flow control (if, while, for, functions)"
	default n
	depends on CONFIG_TOYSH
	help
	  Add flow control to toysh.  This enables the if/then/else/fi,
	  while/do/done, and for/do/done constructs.

	  With pipe support, this enables the ability to define functions
	  using the "function name" or "name()" syntax, plus curly brackets
	  "{ }" to group commands.

config CONFIG_TOYSH_QUOTES
	bool "Smarter argument parsing (quotes)"
	default n
	depends on CONFIG_TOYSH
	help
	  Add support for parsing "" and '' style quotes to the toysh command
	  parser, with lets arguments have spaces in them.


config CONFIG_TOYSH_WILDCARDS
	bool "Wildcards ( ?*{,} )"
	default n
	depends on CONFIG_TOYSH_QUOTES
	help
	  Expand wildcards in argument names, ala "ls -l *.t?z" and
	  "rm subdir/{one,two,three}.txt".

config CONFIG_TOYSH_PROCARGS
	bool "Executable arguments ( `` and $() )"
	default n
	depends on CONFIG_TOYSH_QUOTES
	help
	  Add support for executing arguments contianing $() and ``, using
	  the output of the command as the new argument value(s).

	  (Bash calls this "command substitution".)

config CONFIG_TOYSH_ENVVARS
	bool "Environment variable support"
	default n
	depends on CONFIG_TOYSH_QUOTES
	help
	  Substitute environment variable values for $VARNAME or ${VARNAME},
	  and enable the built-in command "export".

config CONFIG_TOYSH_LOCALS
	bool "Local variables"
	default n
	depends on CONFIG_TOYSH_ENVVARS
	help
	  Support for local variables, fancy prompts ($PS1), the "set" command,
	  and $?.

config CONFIG_TOYSH_ARRAYS
	bool "Array variables"
	default n
	depends on CONFIG_TOYSH_LOCALS
	help
	  Support for ${blah[blah]} style array variables.

config CONFIG_TOYSH_PIPES
	bool "Pipes and redirects ( | > >> < << & && | || () ; )"
	default n
	depends on CONFIG_TOYSH
	help
	  Support multiple commands on the same command line.  This includes
	  | pipes, > >> < redirects, << here documents, || && conditional
	  execution, () subshells, ; sequential execution, and (with job
	  control) & background processes.

config CONFIG_TOYSH_BUILTINS
	bool "Builtin commands"
	default n
	depends on CONFIG_TOYSH
	help
	  Adds the commands exec, fg, bg, help, jobs, pwd, export, source, set,
	  unset, read, alias.

endmenu
```
